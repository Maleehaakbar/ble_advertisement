## CMakeLists.txt
```
cmake_minimum_required(VERSION 3.20.0)
find_package(Zephyr REQUIRED HINTS $ENV{ZEPHYR_BASE})
project(BLE_ADVERTISEMENT)

target_sources(app PRIVATE
  src/main.c
  src/my_lbs.c
)

zephyr_library_include_directories(.)
```

## prj.conf
```kconfig
CONFIG_BT=y                                    #include BLE stack
CONFIG_BT_DEVICE_NAME="Nordic_Peripheral"      #set BLE device name
CONFIG_BT_PERIPHERAL=y                         #add the functionality of peripheral role
CONFIG_BT_GATT_CLIENT=y

CONFIG_DK_LIBRARY=y                             # Button and LED library
CONFIG_LOG=y
         
CONFIG_FPU=y                                   #process float numbers

CONFIG_SYSTEM_WORKQUEUE_STACK_SIZE=2048
CONFIG_MAIN_STACK_SIZE=2048
```

## src/main.c
```c
/*header files for enabling stack,populating advertising data and start advertising*/

#include <zephyr/kernel.h>              /*zephyr/incude/zephyr*/
#include <zephyr/logging/log.h>
#include <zephyr/bluetooth/bluetooth.h>
#include <zephyr/bluetooth/gap.h>
#include <dk_buttons_and_leds.h>       /*nrf/include*/
#include <zephyr/bluetooth/uuid.h>
#include <zephyr/bluetooth/addr.h>
#include <zephyr/bluetooth/conn.h>
#include <zephyr/bluetooth/gatt.h>
#include "my_lbs.h"

LOG_MODULE_REGISTER(Lesson4_Exercise2, LOG_LEVEL_INF);

#define COMPANY_ID_CODE            0x0059
#define DEVICE_NAME     CONFIG_BT_DEVICE_NAME
#define DEVICE_NAME_LEN (sizeof(DEVICE_NAME)-1)
#define USER_BUTTON DK_BTN1_MSK
#define RUN_STATUS_LED DK_LED1
#define RUN_LED_BLINK_INTERVAL 1000
#define CONNECTION_STATUS_LED   DK_LED2
#define USER_LED                DK_LED3
#define USER_BUTTON             DK_BTN1_MSK
#define NOTIFY_INTERVAL         500
#define STACKSIZE 1024
#define PRIORITY 7

struct bt_conn *my_conn = NULL;
static bool app_button_state;
static uint32_t app_sensor_value = 100;

static const struct bt_le_adv_param *adv_param =
	BT_LE_ADV_PARAM(BT_LE_ADV_OPT_CONNECTABLE|BT_LE_ADV_OPT_USE_IDENTITY,
	800,
	801,
	NULL);
    
static const struct bt_data ad[]={                              /*array of advertising packet*/
    BT_DATA_BYTES(BT_DATA_FLAGS, (BT_LE_AD_GENERAL|BT_LE_AD_NO_BREDR)),              /*enable discovery mode flag*/
    BT_DATA(BT_DATA_NAME_COMPLETE,DEVICE_NAME, DEVICE_NAME_LEN),  /*Set advertising packet data*/
};  

static const struct bt_data sd[]={                              /*scan response packet*/
    BT_DATA_BYTES(BT_DATA_UUID128_ALL, BT_UUID_128_ENCODE(0x00001523, 0x1212, 0xefde, 0x1523, 0x785feabcd123)),
};


static void app_led_cb(bool led_state)
{
	dk_set_led(USER_LED, led_state);
}

static bool app_button_cb(void)
{
	return app_button_state;
}

static struct my_lbs_cb app_callbacks = {
	.led_cb = app_led_cb,
	.button_cb = app_button_cb,
};

static void button_changed(uint32_t button_state, uint32_t has_changed)
{   
	if (has_changed & USER_BUTTON) {
        uint32_t user_button_state = button_state & USER_BUTTON;
        my_lbs_send_button_state_indicate(user_button_state);
		app_button_state = user_button_state ? true : false;
       
	}
 
}

void on_connected(struct bt_conn *conn, uint8_t err)
{   
    //struct bt_conn_info info;

    if (err) {
        LOG_ERR("Connection error %d", err);
        return;
    }
    LOG_INF("Connected");
    dk_set_led_on(CONNECTION_STATUS_LED);
    
}

void on_disconnected(struct bt_conn *conn, uint8_t reason)
{
    LOG_INF("Disconnected. Reason %d", reason);
    dk_set_led_off(CONNECTION_STATUS_LED);
   
}

struct bt_conn_cb connection_callbacks = {
    .connected              = on_connected,
    .disconnected           = on_disconnected,
};

static int init_button(void)
{
	int err;

	err = dk_buttons_init(button_changed);
	if (err) {
		printk("Cannot init buttons (err: %d)\n", err);
	}
	return err;
}

static void simulate_data(void)
{
	app_sensor_value++;
	if (app_sensor_value == 200) {
		app_sensor_value = 100;
	}
}

void send_data_thread(void)
{
	while(1){
		/* Simulate data */
		simulate_data();
		/* Send notification, the function sends notifications only if a client is subscribed */
		my_lbs_send_sensor_notify(app_sensor_value);

		k_sleep(K_MSEC(NOTIFY_INTERVAL));
	}
		
}

int main(void)
{
    int blink_status=0;
    int err;

    err = dk_leds_init();
	if (err) {
		LOG_ERR("LEDs init failed (err %d)\n", err);
		return -1;
	}

    err = init_button();
    if (err) {
        LOG_ERR("Cannot init buttons (err: %d)", err);
        return -1;
    }
    
    err=bt_enable(NULL);
    if(err){
        LOG_ERR("Bluetooth init failed (err %d)\n", err);
        return -1;
    }
    LOG_INF(" Bluetooth init");

    bt_conn_cb_register(&connection_callbacks);

    err = my_lbs_init(&app_callbacks);
    if (err) {
	printk("Failed to init LBS (err:%d)\n", err);
	return -1;
    }

    err = bt_le_adv_start(adv_param, ad, ARRAY_SIZE(ad), sd, ARRAY_SIZE(sd));
    if (err) {
	LOG_ERR("Advertising failed to start (err %d)\n", err);
	return -1;
    }
    LOG_INF(" Advertisitment start");

    for(;;){
        dk_set_led(RUN_STATUS_LED, (++blink_status) % 2);
        k_sleep(K_MSEC(RUN_LED_BLINK_INTERVAL));    
    }
}

K_THREAD_DEFINE(send_data_thread_id, STACKSIZE, send_data_thread, NULL, NULL,
    NULL, PRIORITY, 0, 0);
```

## src/my_lbs.c
```c
/*
 * Copyright (c) 2018 Nordic Semiconductor ASA
 *
 * SPDX-License-Identifier: LicenseRef-Nordic-5-Clause
 */

/** @file
 *  @brief LED Button Service (LBS) sample
 */

 #include <zephyr/types.h>
 #include <stddef.h>
 #include <string.h>
 #include <errno.h>
 #include <zephyr/sys/printk.h>
 #include <zephyr/sys/byteorder.h>
 #include <zephyr/kernel.h>
 
 #include <zephyr/bluetooth/bluetooth.h>
 #include <zephyr/bluetooth/hci.h>
 #include <zephyr/bluetooth/conn.h>
 #include <zephyr/bluetooth/uuid.h>
 #include <zephyr/bluetooth/gatt.h>
 #include <zephyr/logging/log.h>
 #include "my_lbs.h"

 
LOG_MODULE_DECLARE(Lesson4_Exercise2);
 
static bool button_state;
static struct my_lbs_cb lbs_cb;
static struct bt_gatt_indicate_params ind_params;
static bool indicate_enabled;
static bool notify_mysensor_enabled;


static void mylbsbc_ccc_cfg_changed(const struct bt_gatt_attr *attr,
    uint16_t value)
{
    indicate_enabled = (value == BT_GATT_CCC_INDICATE);
}

// This function is called when a remote device has acknowledged the indication at its host layer
static void indicate_cb(struct bt_conn *conn, struct bt_gatt_indicate_params *params, uint8_t err)
{
	LOG_DBG("Indication %s\n", err != 0U ? "fail" : "success");
}

static void mylbsbc_ccc_mysensor_cfg_changed(const struct bt_gatt_attr *attr,
    uint16_t value)
{
    notify_mysensor_enabled = (value == BT_GATT_CCC_NOTIFY);
}

 /* STEP 6 - Implement the write callback function of the LED characteristic */
static ssize_t write_led(struct bt_conn *conn,
    const struct bt_gatt_attr *attr,
    const void *buf,
    uint16_t len, uint16_t offset, uint8_t flags)
{
    LOG_INF("Attribute write, handle: %u, conn: %p", attr->handle,
    (void *)conn);

    if (len != 1U) {
    LOG_DBG("Write led: Incorrect data length");
    return BT_GATT_ERR(BT_ATT_ERR_INVALID_ATTRIBUTE_LEN);
    }

    if (offset != 0) {
    LOG_DBG("Write led: Incorrect data offset");
    return BT_GATT_ERR(BT_ATT_ERR_INVALID_OFFSET);
    }

    if (lbs_cb.led_cb) {
    //Read the received value 
    uint8_t val = *((uint8_t *)buf);

    if (val == 0x00 || val == 0x01) {
   //Call the application callback function to update the LED state
   lbs_cb.led_cb(val ? true : false);
    } else {
    LOG_DBG("Write led: Incorrect value");
    return BT_GATT_ERR(BT_ATT_ERR_VALUE_NOT_ALLOWED);
    }
}

return len;
}
 /* STEP 5 - Implement the read callback function of the Button characteristic */
static ssize_t read_button(struct bt_conn *conn,
    const struct bt_gatt_attr *attr,
    void *buf,
    uint16_t len,
    uint16_t offset)
{
//get a pointer to button_state which is passed in the BT_GATT_CHARACTERISTIC() and stored in attr->user_data
    const char *value = attr->user_data;

    LOG_INF("Attribute read, handle: %u, conn: %p", attr->handle,
    (void *)conn);

    if (lbs_cb.button_cb) {
// Call the application callback function to update the get the current value of the button
    button_state = lbs_cb.button_cb();
    return bt_gatt_attr_read(conn, attr, buf, len, offset, value,
           sizeof(*value));
    }

    return 0;
}
 
 /* LED Button Service Declaration */
 /* Create and add the MY LBS service to the Bluetooth LE stack */

BT_GATT_SERVICE_DEFINE(my_lbs_svc,
BT_GATT_PRIMARY_SERVICE(BT_UUID_LBS),
/*Create and add the Button characteristic */
BT_GATT_CHARACTERISTIC(BT_UUID_LBS_BUTTON,
    BT_GATT_CHRC_READ|BT_GATT_CHRC_INDICATE,
    BT_GATT_PERM_READ, read_button, NULL,
    &button_state),
BT_GATT_CCC(mylbsbc_ccc_cfg_changed,
	BT_GATT_PERM_READ | BT_GATT_PERM_WRITE),
/*Create and add the LED characteristic. */
BT_GATT_CHARACTERISTIC(BT_UUID_LBS_LED,
    BT_GATT_CHRC_WRITE,
    BT_GATT_PERM_WRITE,
    NULL, write_led, NULL),
	BT_GATT_CHARACTERISTIC(BT_UUID_LBS_MYSENSOR,
        BT_GATT_CHRC_NOTIFY,
        BT_GATT_PERM_NONE, NULL, NULL,
        NULL),
BT_GATT_CCC(mylbsbc_ccc_mysensor_cfg_changed,
BT_GATT_PERM_READ | BT_GATT_PERM_WRITE),
    
    );
 

 /* A function to register application callbacks for the LED and Button characteristics  */

int my_lbs_send_button_state_indicate(bool button_state)
{
    if (!indicate_enabled) {
        return -EACCES;
    }
 
     /* STEP 5.2 - Populate the indication */
    ind_params.attr = &my_lbs_svc.attrs[2];
    ind_params.func = indicate_cb;
    ind_params.destroy = NULL;
    ind_params.data = &button_state;
    ind_params.len = sizeof(button_state);
    return bt_gatt_indicate(NULL, &ind_params);
}

int my_lbs_send_sensor_notify(uint32_t sensor_value)
{
	if (!notify_mysensor_enabled) {
		return -EACCES;
	}

	return bt_gatt_notify(NULL, &my_lbs_svc.attrs[7], 
			      &sensor_value,
			      sizeof(sensor_value));
}


int my_lbs_init(struct my_lbs_cb *callbacks)
{
    if (callbacks) {
        lbs_cb.led_cb = callbacks->led_cb;
        lbs_cb.button_cb = callbacks->button_cb;
        LOG_INF("Register application callbacks");
    }
 
    return 0;
}
```

## src/my_lbs.h
```c
#ifndef BT_LBS_H_
#define BT_LBS_H_

#ifdef __cplusplus
extern "C" {
#endif

#include <zephyr/types.h>

#define BT_UUID_LBS_VAL \
	BT_UUID_128_ENCODE(0x00001523, 0x1212, 0xefde, 0x1523, 0x785feabcd123)

/** @brief Button Characteristic UUID. */
#define BT_UUID_LBS_BUTTON_VAL \
	BT_UUID_128_ENCODE(0x00001524, 0x1212, 0xefde, 0x1523, 0x785feabcd123)

/** @brief LED Characteristic UUID. */
#define BT_UUID_LBS_LED_VAL \
	BT_UUID_128_ENCODE(0x00001525, 0x1212, 0xefde, 0x1523, 0x785feabcd123)

/** @brief LED Characteristic UUID. */
#define BT_UUID_LBS_MYSENSOR_VAL \
	BT_UUID_128_ENCODE(0x00001526, 0x1212, 0xefde, 0x1523, 0x785feabcd123)


#define BT_UUID_LBS           BT_UUID_DECLARE_128(BT_UUID_LBS_VAL)
#define BT_UUID_LBS_BUTTON    BT_UUID_DECLARE_128(BT_UUID_LBS_BUTTON_VAL)
#define BT_UUID_LBS_LED       BT_UUID_DECLARE_128(BT_UUID_LBS_LED_VAL)
#define BT_UUID_LBS_MYSENSOR  BT_UUID_DECLARE_128(BT_UUID_LBS_MYSENSOR_VAL)

/** @brief Callback type for when an LED state change is received. */
typedef void (*led_cb_t)(const bool led_state);

/** @brief Callback type for when the button state is pulled. */
typedef bool (*button_cb_t)(void);

/** @brief Callback struct used by the LBS Service. */
struct my_lbs_cb {
	/** LED state change callback. */
	led_cb_t led_cb;
	/** Button read callback. */
	button_cb_t button_cb;
};

/** @brief Initialize the LBS Service.
 *
 * This function registers application callback functions with the My LBS
 * Service
 *
 * @param[in] callbacks Struct containing pointers to callback functions
 *			used by the service. This pointer can be NULL
 *			if no callback functions are defined.
 *
 *
 * @retval 0 If the operation was successful.
 *           Otherwise, a (negative) error code is returned.
 */
int my_lbs_init(struct my_lbs_cb *callbacks);

#ifdef __cplusplus
}
#endif

#endif /* BT_LBS_H_ */
```
